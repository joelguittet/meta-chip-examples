## meta-chip-example-1wire/conf/layer.conf
```bitbake
# We have a conf and classes directory, append to BBPATH
BBPATH .= ":${LAYERDIR}"

# We have a recipes directory, add to BBFILES
BBFILES += "${LAYERDIR}/recipes*/*/*.bb ${LAYERDIR}/recipes*/*/*.bbappend"

BBFILE_COLLECTIONS += "meta-chip-example-1wire"
BBFILE_PATTERN_meta-chip-example-1wire := "^${LAYERDIR}/"
BBFILE_PRIORITY_meta-chip-example-1wire = "15"
```

## meta-chip-example-c/conf/layer.conf
```bitbake
# We have a conf and classes directory, append to BBPATH
BBPATH .= ":${LAYERDIR}"

# We have a recipes directory, add to BBFILES
BBFILES += "${LAYERDIR}/recipes*/*/*.bb ${LAYERDIR}/recipes*/*/*.bbappend"

BBFILE_COLLECTIONS += "meta-chip-example-c"
BBFILE_PATTERN_meta-chip-example-c := "^${LAYERDIR}/"
BBFILE_PRIORITY_meta-chip-example-c = "15"
```

## meta-chip-example-java/conf/layer.conf
```bitbake
# We have a conf and classes directory, append to BBPATH
BBPATH .= ":${LAYERDIR}"

# We have a recipes directory, add to BBFILES
BBFILES += "${LAYERDIR}/recipes*/*/*.bb ${LAYERDIR}/recipes*/*/*.bbappend"

BBFILE_COLLECTIONS += "meta-chip-example-java"
BBFILE_PATTERN_meta-chip-example-java := "^${LAYERDIR}/"
BBFILE_PRIORITY_meta-chip-example-java = "15"
```

## meta-chip-example-linux-rt/conf/layer.conf
```bitbake
# We have a conf and classes directory, append to BBPATH
BBPATH .= ":${LAYERDIR}"

# We have a recipes directory, add to BBFILES
BBFILES += "${LAYERDIR}/recipes*/*/*.bb ${LAYERDIR}/recipes*/*/*.bbappend"

BBFILE_COLLECTIONS += "meta-chip-example-xenomai"
BBFILE_PATTERN_meta-chip-example-xenomai := "^${LAYERDIR}/"
BBFILE_PRIORITY_meta-chip-example-xenomai = "15"
```

## meta-chip-example-spidev/conf/layer.conf
```bitbake
# We have a conf and classes directory, append to BBPATH
BBPATH .= ":${LAYERDIR}"

# We have a recipes directory, add to BBFILES
BBFILES += "${LAYERDIR}/recipes*/*/*.bb ${LAYERDIR}/recipes*/*/*.bbappend"

BBFILE_COLLECTIONS += "meta-chip-example-spidev"
BBFILE_PATTERN_meta-chip-example-spidev := "^${LAYERDIR}/"
BBFILE_PRIORITY_meta-chip-example-spidev = "15"
```

## meta-chip-example-wifi-hotspot/conf/layer.conf
```bitbake
# We have a conf and classes directory, append to BBPATH
BBPATH .= ":${LAYERDIR}"

# We have a recipes directory, add to BBFILES
BBFILES += "${LAYERDIR}/recipes*/*/*.bb ${LAYERDIR}/recipes*/*/*.bbappend"

BBFILE_COLLECTIONS += "meta-chip-example-wifi-hotspot"
BBFILE_PATTERN_meta-chip-example-wifi-hotspot := "^${LAYERDIR}/"
BBFILE_PRIORITY_meta-chip-example-wifi-hotspot = "15"
```

## meta-chip-example-wifi/conf/layer.conf
```bitbake
# We have a conf and classes directory, append to BBPATH
BBPATH .= ":${LAYERDIR}"

# We have a recipes directory, add to BBFILES
BBFILES += "${LAYERDIR}/recipes*/*/*.bb ${LAYERDIR}/recipes*/*/*.bbappend"

BBFILE_COLLECTIONS += "meta-chip-example-wifi"
BBFILE_PATTERN_meta-chip-example-wifi := "^${LAYERDIR}/"
BBFILE_PRIORITY_meta-chip-example-wifi = "15"
```
